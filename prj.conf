## CMakeLists.txt
```
cmake_minimum_required(VERSION 3.20.0)

# --- FIX: Prevent ExecuTorch from exporting targets and crashing Zephyr ---
set(EXECUTORCH_ENABLE_INSTALL OFF CACHE INTERNAL "")
set(CMAKE_SKIP_INSTALL_RULES TRUE)
# --------------------------------------------------------------------------

find_package(Zephyr REQUIRED HINTS $ENV{ZEPHYR_BASE})
project(kws_pico2)

set(CMAKE_CXX_STANDARD 17)
set(CMAKE_CXX_STANDARD_REQUIRED ON)

# 1. Add application and processing sources
target_sources(app PRIVATE 
    src/main.c
    src/dcnn/model_runner.cpp
    src/dcnn/model.c
    src/processing/clip.cpp
    src/processing/mfcc.cpp
    src/processing/weights.cpp
    src/comms/uart_api.c
)

# 2. Add include directories (project headers & CMSIS include paths)
target_include_directories(app PRIVATE 
    src/dcnn
    src/processing/includes
    src/comms
    ${ZEPHYR_BASE}/../modules/lib/cmsis-dsp/Include
    ${ZEPHYR_BASE}/../modules/hal/cmsis/CMSIS/Core/Include
)

# 3. Add CMSIS-DSP compile definitions needed for fast FFT tables
target_compile_definitions(app PRIVATE
    ARM_MATH_LOOPUNROLL
    ARM_TABLE_TWIDDLECOEFS_F32
    ARM_TABLE_BITREV_1024
)

# 4. Link ExecuTorch and CMSIS-DSP
# In Zephyr, CMSIS-DSP can be linked via the Zephyr module target or direct archive
target_link_libraries(app PRIVATE 
    executorch 
    portable_ops_lib
)
```

## prj.conf
```kconfig
# Logging
CONFIG_SERIAL=y
CONFIG_CONSOLE=y
CONFIG_UART_CONSOLE=y
CONFIG_UART_INTERRUPT_DRIVEN=y
CONFIG_PRINTK=y

# C++ Support
CONFIG_CPP=y
CONFIG_STD_CPP17=y

# Memory Config
CONFIG_MAIN_STACK_SIZE=16384
CONFIG_HEAP_MEM_POOL_SIZE=32768

# Enable the ExecuTorch Module
CONFIG_EXECUTORCH=y
# Enable floating-point formatting for printk
CONFIG_CBPRINTF_FP_SUPPORT=y

CONFIG_CMSIS_DSP=y
CONFIG_CMSIS_DSP_TRANSFORM=y
CONFIG_CMSIS_DSP_BASICMATH=y
CONFIG_CMSIS_DSP_COMPLEXMATH=y
CONFIG_CMSIS_DSP_FASTMATH=y
CONFIG_CMSIS_DSP_MATRIX=y
CONFIG_CMSIS_DSP_CONTROLLER=n
CONFIG_CMSIS_DSP_STATISTICS=n
```

## src/main.c
```c
#include <zephyr/kernel.h>
#include <zephyr/sys/printk.h>

#include "comms/uart_api.h"
#include "processing/includes/clip.h"
#include "processing/includes/mfcc.h"
#include "dcnn/includes/model_runner.h"

#define BUF_LEN 16000

static float mfcc_features[NUM_MFCC * 49];
float rx_buf[BUF_LEN];

int main(void) {
    int ret;
    uart_init();

    // printk("[+] Boot Up Completed\n");
    // printk("[+] Holding till connection.\n");

    
    // printk("[+] Connection Established.\n");
    // printk("[+] Init Execu runtime\n");
    
    if (init_runtime()){
        // printk("[-] Failed to initialize Execu runtime\n");
        return 0;
    }
    
    mfcc_extractor_handle_t mfcc_handle = mfcc_create();
    // printk("[+] Entring Inference loop\n");
    
    while(1){
        uart_wait_for_host();
        ret = uart_fill_rx_buf(rx_buf, BUF_LEN);

        if(ret < 0){
            // printk("[-] UART receive failed: %d\n", ret);
            continue;
        }

        // printk("[+] Data ready proceeding with prediction\n");

        clip_audio(rx_buf);
        mfcc_process_clip(mfcc_handle, rx_buf, mfcc_features);

        PredResult res = run_inference(mfcc_features);

        // printk("[+] Prediction Result\nclass: %d\npred : %f\n",res.class_id, res.confidence);
        uart_send_result(res);

        k_sleep(K_MSEC(10));
    }
    mfcc_destroy(mfcc_handle);
    // printk("[+] Exiting...\n");
    return 0;
}
```

## src/main.cpp
```c
#include <zephyr/kernel.h>
#include <zephyr/sys/printk.h>

#include "model.h"
#include <memory>
#include <executorch/extension/data_loader/buffer_data_loader.h>
#include <executorch/runtime/core/portable_type/scalar_type.h>
#include <executorch/runtime/executor/memory_manager.h>
#include <executorch/runtime/executor/method.h>
#include <executorch/runtime/executor/program.h>
#include <executorch/runtime/platform/runtime.h>

using namespace executorch::runtime;
using executorch::aten::Tensor;
using executorch::aten::TensorImpl;
using ScalarType = executorch::runtime::etensor::ScalarType;

static uint8_t TIME_FRAMES = 49;
static uint8_t NUM_MFCC = 10;
static uint8_t method_allocator_pool[20 * 1024];
static uint8_t activation_pool[64 * 1024];

int main() {
    printk("\n=== ExecuTorch Zephyr QEMU Test ===\n");

    runtime_init();

    MemoryAllocator method_allocator(sizeof(method_allocator_pool), method_allocator_pool);
    Span<uint8_t> memory_planned_buffers[1] = {{activation_pool, sizeof(activation_pool)}};
    HierarchicalAllocator planned_memory({memory_planned_buffers, 1});
    MemoryManager memory_manager(&method_allocator, &planned_memory);

    std::unique_ptr<Program> program_ptr;
    std::unique_ptr<Method> method_ptr;

    printk("[+] Loading model binary (%u bytes)...\n", dscnn_wake_model_len);
    executorch::extension::BufferDataLoader loader(dscnn_wake_model, dscnn_wake_model_len);
    
    auto program_result = Program::load(&loader);
    if (!program_result.ok()) {
        printk("❌ Failed to load Program flatbuffer!\n");
        return -1;
    }
    program_ptr = std::make_unique<Program>(std::move(*program_result));
    printk("[+] Program loaded successfully.\n");

    auto method_result = program_ptr->load_method("forward", &memory_manager);
    if (!method_result.ok()) {
        printk("❌ Failed to load 'forward' method!\n");
        return -1;
    }
    method_ptr = std::make_unique<Method>(std::move(*method_result));
    printk("[+] Method 'forward' instantiated in memory.\n");

    float input_data[490] = {0};
    TensorImpl::SizesType input_sizes[4] = {1, 1, NUM_MFCC, TIME_FRAMES};
    TensorImpl::DimOrderType dim_order[4] = {0, 1, 2, 3};

    TensorImpl input_impl(ScalarType::Float, 4, input_sizes, input_data, dim_order);
    Tensor input(&input_impl);

    if (method_ptr->set_input(input, 0) != Error::Ok) {
        printk("❌ Failed to bind input tensor!\n");
        return -1;
    }

    printk("[+] Running inference pass...\n");
    if (method_ptr->execute() != Error::Ok) {
        printk("❌ Execution failed!\n");
        return -1;
    }

    auto output_evalue = method_ptr->get_output(0);
    Tensor output = output_evalue.toTensor();
    float* output_data = output.mutable_data_ptr<float>();

    printk("✅ Inference successful! First output value: %f\n", (double)output_data[0]);

    return 0;
}
```
